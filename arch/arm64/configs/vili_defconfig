## arch/arm64/configs/vili_defconfig
```kconfig
# ==========================================
# Core Architecture & SM8350 (Lahaina) Base
# ==========================================
CONFIG_ARCH_LAHAINA=y
CONFIG_ARM64=y
CONFIG_64BIT=y
CONFIG_SMP=y
CONFIG_NR_CPUS=8
CONFIG_HZ_300=y
CONFIG_LOCALVERSION="-NEXTGEN"
CONFIG_LOCALVERSION_AUTO=n

# ==========================================
# QGKI & Module Loading (HyperOS Compatibility)
# ==========================================
CONFIG_GKI_HACKS_TO_FIX=y
CONFIG_MODULES=y
CONFIG_MODULE_UNLOAD=y
CONFIG_MODVERSIONS=n
CONFIG_MODULE_SIG=n
CONFIG_MODULE_SIG_ALL=n
CONFIG_MODULE_SIG_FORCE=n
CONFIG_TRIM_UNUSED_KSYMS=n

# ==========================================
# Full eBPF & Cgroup Support (HyperOS 4 / Android 15-16 Boot)
# ==========================================
CONFIG_BPF=y
CONFIG_BPF_SYSCALL=y
CONFIG_BPF_JIT=y
CONFIG_BPF_JIT_ALWAYS_ON=y
CONFIG_BPF_UNPRIV_DEFAULT_OFF=n
CONFIG_CGROUPS=y
CONFIG_CGROUP_BPF=y
CONFIG_CGROUP_SCHED=y
CONFIG_CGROUP_FREEZER=y
CONFIG_CGROUP_NET_PRIO=y
CONFIG_CGROUP_NET_CLASSID=y
CONFIG_MEMCG=y
CONFIG_SOCK_CGROUP_DATA=y
CONFIG_NETFILTER_XT_MATCH_BPF=y
CONFIG_NET_CLS_BPF=y
CONFIG_NET_ACT_BPF=y
CONFIG_BPF_STREAM_PARSER=y
CONFIG_LWTUNNEL_BPF=y
CONFIG_HAVE_EBPF_JIT=y
CONFIG_BPF_EVENTS=y
CONFIG_NET_SCH_INGRESS=y
CONFIG_NET_INGRESS=y
CONFIG_NET_EGRESS=y
CONFIG_INET_UDP_DIAG=y
CONFIG_INET_TCP_DIAG=y
CONFIG_INET_DIAG_DESTROY=y
CONFIG_XDP_SOCKETS=y

# ==========================================
# Xiaomi 11T Pro (Vili) Specific Hardware
# ==========================================
CONFIG_MACH_XIAOMI=y
CONFIG_MACH_XIAOMI_SM8350=y
CONFIG_MACH_XIAOMI_VILI=y

# Vili Touchscreen (Goodix / Focaltech / Xiaomi Touch)
CONFIG_INPUT_TOUCHSCREEN=y
CONFIG_TOUCHSCREEN_XIAOMI_TOUCHFEATURE=y
CONFIG_TOUCHSCREEN_GOODIX_BRL=y
CONFIG_TOUCHSCREEN_GOODIX_GTX8=y
CONFIG_TOUCHSCREEN_FTS=y
CONFIG_TOUCHSCREEN_FTS_521=y
CONFIG_TOUCHSCREEN_NT36XXX=y

# Vili Audio (Harmon Kardon / Cirrus Logic / TFA98xx / Q6DSP)
CONFIG_SND_SOC_SM8350=y
CONFIG_SND_SOC_WSA883X=y
CONFIG_SND_SOC_WCD938X=y
CONFIG_SND_SOC_CS35L41=y
CONFIG_SND_SOC_CS35L41_I2C=y
CONFIG_SND_SOC_TFA98XX=y
CONFIG_SND_SOC_TFA9874=y

# Vili Display, Fingerprint & 120W Fast Charging
CONFIG_DRM_MSM=y
CONFIG_DRM_MSM_DSI=y
CONFIG_MI_DISP=y
CONFIG_XIAOMI_FINGERPRINT=y
CONFIG_FINGERPRINT_GOODIX_FOD=y
CONFIG_FINGERPRINT_FPC1020=y
CONFIG_XIAOMI_USB_PD=y
CONFIG_BQ2597X_CHARGE_PUMP=y
CONFIG_LN8000_CHARGE_PUMP=y
CONFIG_MI_THERMAL_INTERFACE=y

# ==========================================
# Filesystems & Root (KernelSU + EROFS + F2FS)
# ==========================================
CONFIG_EROFS_FS=y
CONFIG_EROFS_FS_ZIP=y
CONFIG_F2FS_FS=y
CONFIG_F2FS_FS_XATTR=y
CONFIG_F2FS_FS_POSIX_ACL=y
CONFIG_F2FS_FS_SECURITY=y
CONFIG_F2FS_FS_COMPRESSION=y
CONFIG_EXT4_FS=y
CONFIG_OVERLAY_FS=y
CONFIG_TMPFS_XATTR=y
CONFIG_KSU=y
```
